## CMakeLists.txt
```
cmake_minimum_required(VERSION 3.20.0)

list(APPEND BOARD_ROOT ${CMAKE_CURRENT_SOURCE_DIR}/..)
find_package(Zephyr REQUIRED HINTS ${ZEPHYR_BASE})
project(my_zephyr_app)

target_sources(app PRIVATE src/main.c)
add_subdirectory(${CMAKE_CURRENT_SOURCE_DIR}/../drivers/our_driver ${CMAKE_CURRENT_BINARY_DIR}/drivers/our_driver)
```

## Kconfig
```
menu "Zephyr configuration"
    source "kconfig.zephyr"

endmenu

config APP_HEARTBEAT_PERIOD_MS
    int "Heartbeat period (ms)"
    default 500
    range 100 2000
    help
        "Set the period for the heartbeat LED in milliseconds. This controls how often the LED will toggle to indicate that the system is running."


menuconfig LED_Subsystem
    bool "LED Subsystem"
    default n
    help
        "Enable the LED Subsystem for controlling LEDs on the board."


choice
    prompt "LED blink sleep time"
    depends on LED_Subsystem
    default BLINK_1000MS

config  BLINK_250MS
    bool "250ms ( VERY FAST)"
config  BLINK_500MS
    bool "500ms (FAST)"
config  BLINK_1000MS
    bool "1s (MEDIUM)"
config  BLINK_2000MS
    bool "2s (SLOW)"

endchoice


menuconfig Advanced_LED_Setting
    bool "Advanced LED settings"
    depends on LED_Subsystem
    default n
    help
        "Enable advanced LED settings for more control over LED behavior."

config LED_BRIGHTNESS
    int "LED brightness (0-100)"
    depends on Advanced_LED_Setting
    default 100     
    range 0 100
    help
        "Set the brightness level of the LED (0-100%)."

config LED_FADE_DURATION
    int "LED dade duration (ms)"
    depends on Advanced_LED_Setting
    default 500     
    range 0 500
    help
        "Set the duration for LED fade in and fade out effects in milliseconds."

menu "Expert Settings"
    depends on LED_Subsystem
    visible if Advanced_LED_Setting

    menuconfig Enable_LED_debugging
    bool "Enable LED debugging"      
    default n
    help
        "Enable debugging features for the LED subsystem, such as logging LED state changes and errors."

    menuconfig Custom_blink_pattern
    bool "Custom blink pattern"
    default n
    help
        "Enable custom blink patterns for the LED, allowing for more complex behaviors than simple on/off blinking."
endmenu

rsource "../drivers/our_driver/Kconfig"
```

## prj.conf
```kconfig
CONFIG_GPIO=y

# CONFIG_BLINK_TIME_IN_MS=500
# CONFIG_BLINK_500MS=y
# console
CONFIG_CONSOLE=y
CONFIG_UART_CONSOLE=y
CONFIG_OUR_DRIVER=y
CONFIG_LOG=y
CONFIG_SHELL=y
```

## app.overlay
```dts
/ {
    our_driver0: our_driver {
        compatible = "our,driver";
        status = "okay";
    };

};
```

## src/main.c
```c
#include <stdio.h>
#include <zephyr/device.h>
#include <zephyr/devicetree.h>
#include <zephyr/drivers/sensor.h>
#include <zephyr/logging/log.h>
#include "../../drivers/our_driver/our_driver.h"

LOG_MODULE_REGISTER(main, LOG_LEVEL_INF);

int main(void)
{
	printf("Hello World! %s\n", CONFIG_BOARD_TARGET);
static const struct device *dev = DEVICE_DT_GET(DT_NODELABEL(our_driver0));
	

	if (!device_is_ready(dev)) {
		LOG_ERR("Device not ready");
		return 0;;
	}
	volatile int ret;
	struct sensor_value val;

	our_driver_set_parameter(dev, 42);

	while(1)
	{
		k_sleep(K_SECONDS(1));
	}

	return 0;
}
```
