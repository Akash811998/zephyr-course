## boards/task2_board/Kconfig.task2_board
```kconfig
# Copyright (c) 2016 Linaro Limited.
# SPDX-License-Identifier: Apache-2.0

config BOARD_TASK2_BOARD
	select SOC_STM32F401XE
```

## boards/task2_board/board.yml
```yaml
board:
  name: task2_board
  full_name: IOMICO Test Board Nucleo F401RE
  vendor: st
  socs:
    - name: stm32f401xe
```
